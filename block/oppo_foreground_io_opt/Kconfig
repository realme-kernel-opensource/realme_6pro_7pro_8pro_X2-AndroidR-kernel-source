## block/oppo_foreground_io_opt/Kconfig
```kconfig
# SPDX-License-Identifier: GPL-2.0-only
# Copyright (C) 2018-2020 Oplus. All rights reserved.

config OPPO_FG_IO_OPT
       bool "Enable oppo foreground io optimization"
       depends on FG_TASK_UID
       default y
       help
         oppo foreground io optimization
```

## drivers/input/oppo_fp_drivers/Kconfig
```kconfig
menuconfig OPPO_FINGERPRINT
	bool "OPLUS fingerprint"
	depends on SPI_MASTER
	help
	  Say Y here to enable OPLUS fingerprint support

if OPPO_FINGERPRINT
### platform config
config OPPO_FINGERPRINT_QCOM
       default n
       tristate "Fingerprint base on QCOM"

config OPPO_FINGERPRINT_MTK
       default n
       tristate "Fingerprint base on MTK"

### fingerprint sensor config
config OPPO_FINGERPRINT_FPC
       default n
       tristate "Fingerprint base on fpc capacitive chip"
config OPPO_FINGERPRINT_GOODIX
       default n
       tristate "Fingerprint base on goodix capacitive chip"
config OPPO_FINGERPRINT_GOODIX_OPTICAL
       default n
       tristate "Fingerprint base on goodix optical chip"
config OPPO_FINGERPRINT_SILEAD_OPTICAL
       default n
       tristate "Fingerprint base on silead optical chip"
config OPPO_FINGERPRINT_EGIS_OPTICAL
       default n
       tristate "Fingerprint base on egis optical chip"
config OPPO_FINGERPRINT_EGIS
       default n
       tristate "Fingerprint base on egis chip"
config OPPO_FINGERPRINT_SILEAD
       default n
       tristate "Fingerprint base on silead chip"
config OPPO_FINGERPRINT_JIIOV_OPTICAL
       default n
       tristate "Fingerprint base on jiiov optical chip"
config OPPO_FINGERPRINT_CHIPONE
       default n
       tristate "Fingerprint base on chipone chip"

### fingerprint feature config
config OPPO_FINGERPRINT_NAVIGATION_ENABLE
       default n
       tristate "Fingerprint navigation function"

endif #OPPO_FINGERPRINT
```

## drivers/input/touchscreen/oppo_touchscreen/Focal/Kconfig
```kconfig
source "drivers/input/touchscreen/oppo_touchscreen/Focal/FT8006/Kconfig"
source "drivers/input/touchscreen/oppo_touchscreen/Focal/ft3518/Kconfig"
```

## drivers/input/touchscreen/oppo_touchscreen/Focal/ft3518/Kconfig
```kconfig
config TOUCHPANEL_FOCAL_FT3518
	bool "TP Focal_FT3518 IC enable or not for OPPO"
	---help---
	say Y to enable driver for Touchpanel using Focal FT3518

config TOUCHPANEL_FOCAL_FT3518_GPIO_DEBUG
	bool "TP Focal_FT3518 IC gpio debug enable or not"
	---help---
	say Y to enable gpio debug for Touchpanel Focal FT3518
```

## drivers/input/touchscreen/oppo_touchscreen/Goodix/GT9886/Kconfig
```kconfig
config TOUCHPANEL_GOODIX_GT9886
#   default y
    bool "TP goodix gt9886 IC enable or not for OPPO"
    ---help---
    say Y to enable driver for Touchpanel useing goodix gt9886

#endif
```

## drivers/input/touchscreen/oppo_touchscreen/Novatek/Kconfig
```kconfig
config TOUCHPANEL_NT_DIGITALNOISE_TEST
#   default y
    bool "TP nova nt36672C IC add digital noise test or not for OPPO"
    ---help---
    say Y to add digital noise test

source "drivers/input/touchscreen/oppo_touchscreen/Novatek/NT36672/Kconfig"
source "drivers/input/touchscreen/oppo_touchscreen/Novatek/NT36525/Kconfig"
source "drivers/input/touchscreen/oppo_touchscreen/Novatek/NT36672_noflash/Kconfig"
source "drivers/input/touchscreen/oppo_touchscreen/Novatek/NT36525_noflash/Kconfig"
source "drivers/input/touchscreen/oppo_touchscreen/Novatek/NT36525B_noflash/Kconfig"
source "drivers/input/touchscreen/oppo_touchscreen/Novatek/NT36672C_noflash/Kconfig"
```

## drivers/input/touchscreen/oppo_touchscreen/Samsung/S6SY771/Kconfig
```kconfig
#ifdef OPLUS_FEATURE_TP_BASIC
#Added by Zengpeng.Chen@Bsp.group.Tp for Samsung s6sy771 ic driver

config TOUCHPANEL_SAMSUNG_S6SY771
#	default y
	bool "TP Samsung s6sy771 IC enable or not for OPPO"
	---help---
	say Y to enable driver for Touchpanel using Samsung s6sy771

#endif
```

## drivers/input/touchscreen/oppo_touchscreen/Samsung/S6SY791/Kconfig
```kconfig
#ifdef OPLUS_FEATURE_TP_BASIC
#Added by Cong.Dai@Bsp.group.Tp for Samsung s6sy791 ic driver

config TOUCHPANEL_SAMSUNG_S6SY791
#	default y
	bool "TP Samsung s6sy791 IC enable or not for OPPO"
	---help---
	say Y to enable driver for Touchpanel using Samsung s6sy791

#endif
```

## drivers/input/touchscreen/oppo_touchscreen/Samsung/S6SY792/Kconfig
```kconfig
#ifdef OPLUS_FEATURE_TP_BASIC
#Added by Zengpeng.Chen@Bsp.group.Tp for Samsung s6sy792 ic driver

config TOUCHPANEL_SAMSUNG_S6SY792
#	default y
	bool "TP Samsung s6sy792 IC enable or not for OPPO"
	---help---
	say Y to enable driver for Touchpanel using Samsung s6sy792

#endif
```

## drivers/input/touchscreen/oppo_touchscreen/ilitek/Kconfig
```kconfig
source "drivers/input/touchscreen/oppo_touchscreen/ilitek/ilitek9881h/Kconfig"
source "drivers/input/touchscreen/oppo_touchscreen/ilitek/ilitek9881h_v2/Kconfig"
source "drivers/input/touchscreen/oppo_touchscreen/ilitek/ilitek9881h_v3/Kconfig"
source "drivers/input/touchscreen/oppo_touchscreen/ilitek/ilitek9881h_v4/Kconfig"
source "drivers/input/touchscreen/oppo_touchscreen/ilitek/ilitek9882n/Kconfig"
```

## drivers/soc/oplus/Kconfig
```kconfig
source "drivers/soc/oplus/system/Kconfig"
#endif /* VENDOR_EDIT */

#ifdef OPLUS_FEATURE_LOWMEM_DBG
source "drivers/soc/oplus/lowmem_dbg/Kconfig"
##endif /* OPLUS_FEATURE_LOWMEM_DBG */
```

## drivers/soc/oplus/system/Kconfig
```kconfig
# SPDX-License-Identifier: GPL-2.0-only
# Copyright (C) 2018-2020 Oplus. All rights reserved.
config OPLUS_SYSTEM_KERNEL
  bool "config oplus system feature "
  default y
  help
	define this config to add oplus sytstem kernel feature

config OPPO_ARCH_FILE
  bool "for build directory oppo"
  ---help---
  say Y to buid in

config OPPO_COMMON_SOFT
  bool "config oppo common software"
  select OPPO_ARCH_FILE
  help
	define this config to get project verion from sharemem.
	Maybe this value is from CDT or dynamic identify by hardware
	id.

config OPPO_DEVICE_IFNO
  tristate "config oppo devinfo"
  select OPPO_ARCH_FILE
  help
	define this config to compile devinfo.c for device register
		.

config OPLUS_FEATURE_DETAILHEAD
  tristate "config detail kmsg"
    help
        define this config to add cpu number and current id and current comm to kmsg

source "drivers/soc/oplus/system/feedback/Kconfig"
source "drivers/soc/oplus/system/uboot_log/Kconfig"
source "drivers/soc/oplus/system/shutdown_detect/Kconfig"
source "drivers/soc/oplus/system/slabtrace/Kconfig"
source "drivers/soc/oplus/system/oplus_project/Kconfig"
source "drivers/soc/oplus/system/qcom_minidump/Kconfig"
source "drivers/soc/oplus/system/hung_task_enhance/Kconfig"
source "drivers/soc/oplus/system/oppo_phoenix/Kconfig"
source "drivers/soc/oplus/system/oppo_pmic_monitor/Kconfig"
source "drivers/soc/oplus/system/oppo_saupwk/Kconfig"
source "drivers/soc/oplus/system/project_info/Kconfig"
source "drivers/soc/oplus/system/cmdline_parser/Kconfig"
source "drivers/soc/oplus/system/dump_device_info/Kconfig"
source "drivers/soc/oplus/system/mdmrst/Kconfig"
source "drivers/soc/oplus/system/full_aging/Kconfig"
#ifdef OPLUS_FEATURE_ESIM
#ChenGuoyao@NETWORK.SIM,2020/06/10, Add for eSIM
source "drivers/soc/oplus/system/oppo_gpio/Kconfig"
#endif /* OPLUS_FEATURE_ESIM */
#ifdef OPLUS_FEATURE_QCOM_PMICWD
#ZhangFei@BSP.Kernel.Stability, 2020/04/03, Add for qcom pmic watchdog
source "drivers/soc/oplus/system/qcom_pmicwd/Kconfig"
#endif /* OPLUS_FEATURE_QCOM_PMICWD */

#ifdef OPLUS_FEATURE_MM_FEEDBACK
#Zhao.Pan@MULTIMEDIA.AUDIODRIVER.KERNEL, 2020/08/08, Add for multimedia kevent feedback driver
source "drivers/soc/oplus/system/oplus_mm_fb/Kconfig"
#endif /* OPLUS_FEATURE_MM_FEEDBACK */

#ifdef OPLUS_FEATURE_QCOM_WATCHDOG
#yanghao@BSP.Kernel.Stability, 2020/04/03, Add for qcom pmic watchdog
source "drivers/soc/oplus/system/qcom_watchdog/Kconfig"
#endif /* OPLUS_FEATURE_QCOM_WATCHDOG */

#ifdef OPLUS_FEATURE_ACM
#Yuwei.Guan@BSP.Kernel.FS,2020/07/08, Add for acm
source "drivers/soc/oplus/system/acm/Kconfig"
#endif /* OPLUS_FEATURE_ACM */
#ifdef OPLUS_FEATURE_THEIA
#yanggang@BSP.Kernel.Stability,2020/07/08, Add for theia
source "drivers/soc/oplus/system/theia/Kconfig"
#endif /* OPLUS_FEATURE_THEIA */
#ifdef OPLUS_FEATURE_MISC
#terry.zhong@OPTI.Kernel.Stability, 2020/09/7, enable oplus misc feature
source "drivers/soc/oplus/system/misc/Kconfig"
#endif /* OPLUS_FEATURE_MISC */
```

## drivers/soc/oplus/system/oplus_mm_fb/Kconfig
```kconfig
#Zhao.Pan@MULTIMEDIA.AUDIODRIVER.KERNEL, 2020/08/08, Add for multimedia kevent feedback driver
config OPLUS_FEATURE_MM_FEEDBACK
  bool "Oplus multimedia kevent feedback"
  default n
  help
    define this config to init oplus multimedia kevent feedback driver
```

## drivers/soc/oplus/system/oppo_gpio/Kconfig
```kconfig
#ChenGuoyao@NETWORK.IMS 2020/06/10, Add for control oppo gpio
#change 'y' to 'n', if you want fo close this controller
config OPLUS_OPPO_GPIO
    bool "oppo gpio controller"
    default n
    help
      define this config to control oppo gpio.
```

## drivers/soc/oplus/system/oppo_pmic_monitor/Kconfig
```kconfig
# SPDX-License-Identifier: GPL-2.0-only
# Copyright (C) 2018-2020 Oplus. All rights reserved.
#change 'y' to 'n', if you want fo close pmic monitor
config OPLUS_FEATURE_PMIC_MONITOR
    tristate "oppo pmic monitor"
    default n
    help
      define this config to init oppo pmic monitor.
```

## drivers/soc/oplus/system/oppo_saupwk/Kconfig
```kconfig
# SPDX-License-Identifier: GPL-2.0-only
# Copyright (C) 2018-2020 Oplus. All rights reserved.
#Bin.Wen@TECH.BSP.Stability.SAUPWK 2020/06/15, Add for SAUPWK
#change 'y' to 'n', if you want fo close saupwk feature
config OPLUS_FEATURE_SAUPWK
    tristate "oppo saupwk project"
    default n
    help
      define this config to init oppo saupwk.
```

## drivers/soc/oppo/Kconfig
```kconfig
config OPPO_ARCH_FILE
  bool "for build directory oppo"
  ---help---
  say Y to buid in

config OPPO_COMMON_SOFT
  bool "config oppo common software"
  select OPPO_ARCH_FILE
  help
  define this config to get project verion from sharemem.
  Maybe this value is from CDT or dynamic identify by hardware
  id.

config OPPO_DEVICE_IFNO
  bool "config oppo devinfo"
  select OPPO_ARCH_FILE
  help
	define this config to compile devinfo.c for device register

source "drivers/soc/oppo/project_info/Kconfig"
source "drivers/soc/oppo/device_info/Kconfig"

#ifdef OPLUS_ARCH_EXTENDS
source "drivers/soc/oppo/oppo_kevent_feedback/Kconfig"
#endif /* OPLUS_ARCH_EXTENDS */
```

## drivers/soc/oppo/oppo_healthinfo/Kconfig
```kconfig
#ifdef OPLUS_FEATURE_HEALTHINFO
#//wenbin.liu@PSW.Kernel.MM, 2018/05/23, Add for Healthinfo monitor
config OPPO_HEALTHINFO
bool "config oppo healthinfo"
help
    define this config to init oppo healthinfo.
config CAMERA_OPT
	bool "config camera opt"
	default n
	help
	  reduce camera provider task runnable time
#endif /* OPLUS_FEATURE_HEALTHINFO */
```

## drivers/soc/oppo/oppo_kevent_feedback/Kconfig
```kconfig
#ifdef OPLUS_ARCH_EXTENDS
config OPPO_CRITICALLOG
bool "config oppo kevent feedback"
help
    define this config to init oppo kevent feedback driver.
#endif /* OPLUS_ARCH_EXTENDS */
```

## fs/proc/oppo_healthinfo/Kconfig
```kconfig
#ifdef VENDOR_EDIT
#Huacai.Zhou@PSW.BSP.kernel.Peformance, 2018/06/18, add foreground process opt support
config FG_TASK_UID
	bool "Enable /proc/fg_info/ if EXPERT"
	default y
	help
	  Add foreground process optimize support to promote performance .
#endif /*VENDOR_EDIT*/
#ifdef VENDOR_EDIT
#Liujie.Xie@TECH.Kernel.Sched, 2020/05/20, add jank monitor opt support
config OPPO_JANK_INFO
	bool "Enable /proc/pid/jank_info if EXPERT"
	default n
	help
	  Add jank monitor opt support .
#endif /*VENDOR_EDIT*/
```

## include/linux/uifirst/Kconfig
```kconfig
config OPLUS_FEATURE_UIFIRST
	tristate "uifirst"
	default n
	help
	  turning sched for ui, render and so on to improve UX
```

## mm/multi_kswapd/Kconfig
```kconfig
# SPDX-License-Identifier: GPL-2.0-only
# Copyright (C) 2018-2020 Oplus. All rights reserved.

config OPLUS_MULTI_KSWAPD
       bool "Enable multi kswapd"
       default n
       help
         multi kswapd
```

## mm/oppo_healthinfo/Kconfig
```kconfig
#ifdef OPLUS_FEATURE_HEALTHINFO
#/* Huacai.Zhou@PSW.BSP.Kernel.MM, 2018-07-07, add alloc wait monitor support*/
config OPPO_MEM_MONITOR
	bool "memory monitor "
	default n
	help
	 memory monitor.
#endif /* OPLUS_FEATURE_HEALTHINFO */
```
